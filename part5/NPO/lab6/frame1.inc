[ ] 
[+] window MainWin X4TEST
	[ ] locator "/MainWin[@caption='4TEST']"
	[-] Control DirectUIHWND
		[ ] locator "[@windowClassName='DirectUIHWND'][3]"
	[-] MenuItem New
		[ ] locator "New"
	[-] Control ShellView
		[ ] locator "ShellView"
	[-] MenuItem TextDocument
		[ ] locator "Text Document"
	[-] TextField TextField
		[ ] locator "//TextField"
	[-] TextField TextField1
		[ ] locator "[2]"
[-] window MainWin Lab6
	[ ] locator "/MainWin[@caption='lab6']"
	[-] Control DirectUIHWND
		[ ] locator "[@windowClassName='DirectUIHWND'][3]"
	[-] MenuItem New
		[ ] locator "New"
	[-] Control ShellView
		[ ] locator "ShellView"
	[-] MenuItem TextDocument
		[ ] locator "Text Document"
	[-] TextField TextField
		[ ] locator "[2]"
